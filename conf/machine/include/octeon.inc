## conf/machine/include/octeon.inc
```bitbake
# Cavium Octeon Soc 

SOC_FAMILY = "octeon"
include conf/machine/include/soc-family.inc
require conf/machine/include/mips/tune-octeon.inc

IMAGE_FSTYPES += "ext4 tar.gz"

SERIAL_CONSOLES ?= "115200;ttyS0 115200;ttyS1"

MACHINE_EXTRA_RRECOMMENDS ?= " kernel-modules"
PREFERRED_VERSION_linux-yocto ?= "6.6%"
PREFERRED_PROVIDER_virtual/kernel ?= "linux-yocto"
```

## conf/machine/include/octeon3.inc
```bitbake
# Cavium Octeon III

DEFAULTTUNE ?= "octeon2"
include conf/machine/include/octeon.inc

KERNEL_IMAGETYPE ?= "vmlinux.64"
KERNEL_OUTPUT ?= "vmlinux.64"

MACHINE_EXTRA_RRECOMMENDS += "kernel-module-octeon-ethernet"
```

## conf/machine/sff-ref-cn71xx-64.conf
```bitbake
#@TYPE: Machine
#@NAME: Cavium Small Form Factor Reference CN7000 evb 64bit
#@DESCRIPTION: sff-ref-cn71xx-64

DEFAULTTUNE = "octeon3_64"
require conf/machine/include/octeon3.inc


PREFERRED_VERSION_linux-yocto-lts = "4.14%"
PREFERRED_PROVIDER_virtual/kernel = "linux-octeon-lts"

#PREFERRED_VERSION_linux-yocto = "6.6%"
#PREFERRED_PROVIDER_virtual/kernel = "linux-yocto"

IMAGE_BOOT_FILES += " \
    vmlinux.64;vmlinux.64 \
"

IMAGE_FSTYPES += "wic"

WKS_FILE = "octeon-sff7000.wks"

OLDEST_KERNEL:sff-ref-cn71xx-64 = "4.14"

MACHINE_FEATURES_BACKFILL_CONSIDERED:sff-ref-cn71xx-64:append = " qemu-usermode"
```

## wic/octeon-sff7000.wks
```
# short-description: OCTEON III (SFF7000) SD/eMMC image: FAT32 boot + ext4 root
# long-description: Partition 1 holds vmlinux.64 + DTBs for bootoctlinux.
#                   Partition 2 is the ext4 root filesystem.

# Boot partition (FAT32) with kernel+dtbs placed by Yocto's IMAGE_BOOT_FILES
part /boot --source bootimg-partition --ondisk mmcblk0 --fstype=vfat --label boot --active --align 1024 --size 256

# Root filesystem partition (ext4), created from the built rootfs
part / --source rootfs --ondisk mmcblk0 --fstype=ext4 --label rootfs --align 4096
```
